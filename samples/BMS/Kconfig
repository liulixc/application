## samples/BMS/Kconfig
```kconfig
config SAMPLE_SUPPORT_BMS_SLAVE
    bool
    prompt "Support BMS_SLAVE Sample."
    default n
    depends on ENABLE_BMS_SAMPLE
    help
        This option means support BMS_SLAVE Sample.

if SAMPLE_SUPPORT_BMS_SLAVE
menu "BMS Slave Sample Configuration"
    osource "application/samples/BMS/bms_slave/Kconfig"
endmenu
endif       

config SAMPLE_SUPPORT_BMS_GATEWAY
    bool
    prompt "Support BMS_GATEWAY Sample."
    default n
    depends on ENABLE_BMS_SAMPLE
    help
        This option means support BMS_GATEWAY Sample.

config SAMPLE_SUPPORT_OTA
    bool
    prompt "Support OTA Sample."
    default n
    depends on ENABLE_BMS_SAMPLE
    help
        This option means support OTA Sample.

config SAMPLE_SUPPORT_HTTP
    bool
    prompt "Support HTTP Sample."
    default n
    depends on ENABLE_BMS_SAMPLE
    help
        This option means support HTTP Sample.

config SAMPLE_SUPPORT_UART_OTA
    bool
    prompt "Support UART OTA Sample."
    default n
    depends on ENABLE_BMS_SAMPLE
    help
        This option means support UART OTA Sample.
```

## samples/BMS/bms_slave/Kconfig
```kconfig
config ADC_CHANNEL
    int
    prompt "Choose ADC channel."
    default 5

config SUPPORT_SLE_PERIPHERAL
    bool
    default y
```

## samples/Farsight/Kconfig
```kconfig
config SAMPLE_SUPPORT_KERNEL_01_TASK
    bool
    prompt "Support KERNEL_01_TASK Sample."
    default n
    depends on ENABLE_FARSIGHT_SAMPLE
    help
        This option means support KERNEL_01_TASK Sample.

config SAMPLE_SUPPORT_KERNEL_02_TIMER
    bool
    prompt "Support KERNEL_02_TIMER Sample."
    default n
    depends on ENABLE_FARSIGHT_SAMPLE
    help
        This option means support KERNEL_02_TIMER Sample.

config SAMPLE_SUPPORT_KERNEL_03_EVENT
    bool
    prompt "Support KERNEL_03_EVENT Sample."
    default n
    depends on ENABLE_FARSIGHT_SAMPLE
    help
        This option means support KERNEL_03_EVENT Sample.

config SAMPLE_SUPPORT_KERNEL_04_MUTEX
    bool
    prompt "Support KERNEL_04_MUTEX Sample."
    default n
    depends on ENABLE_FARSIGHT_SAMPLE
    help
        This option means support KERNEL_04_MUTEX Sample.

config SAMPLE_SUPPORT_KERNEL_05_MUTEX_SEMAPHORE
    bool
    prompt "Support KERNEL_05_MUTEX_SEMAPHORE Sample."
    default n
    depends on ENABLE_FARSIGHT_SAMPLE
    help
        This option means support KERNEL_05_MUTEX_SEMAPHORE Sample.

config SAMPLE_SUPPORT_KERNEL_06_SYNC_SEMAPHORE
    bool
    prompt "Support KERNEL_06_SYNC_SEMAPHORE Sample."
    default n
    depends on ENABLE_FARSIGHT_SAMPLE
    help
        This option means support KERNEL_06_SYNC_SEMAPHORE Sample.

config SAMPLE_SUPPORT_KERNEL_07_COUNT_SEMAPHORE
    bool
    prompt "Support KERNEL_07_COUNT_SEMAPHORE Sample."
    default n
    depends on ENABLE_FARSIGHT_SAMPLE
    help
        This option means support KERNEL_07_COUNT_SEMAPHORE Sample.

config SAMPLE_SUPPORT_KERNEL_08_MESSGE_QUEQUE
    bool
    prompt "Support KERNEL_08_MESSGE_QUEQUE Sample."
    default n
    depends on ENABLE_FARSIGHT_SAMPLE
    help
        This option means support KERNEL_08_MESSGE_QUEQUE Sample.

config SAMPLE_SUPPORT_KERNEL_09_NV
    bool
    prompt "Support KERNEL_09_NV Sample."
    default n
    depends on ENABLE_FARSIGHT_SAMPLE
    help
        This option means support KERNEL_09_NV Sample.


config SAMPLE_SUPPORT_LEDBLINK
    bool
    prompt "Support LEDBLINK Sample."
    default n
    depends on ENABLE_FARSIGHT_SAMPLE
    help
        This option means support LEDBLINK Sample.

config SAMPLE_SUPPORT_UART
    bool
    prompt "Support UART Sample."
    default n
    depends on ENABLE_FARSIGHT_SAMPLE
    help
        This option means support UART Sample.
        
config SAMPLE_SUPPORT_OLED_SSD1306
    bool
    prompt "Support OLED_SSD1306 Sample."
    default n
    depends on ENABLE_FARSIGHT_SAMPLE
    help
        This option means support OLED_SSD1306 Sample.

config SAMPLE_SUPPORT_RGB
    bool
    prompt "Support RGB Sample."
    default n
    depends on ENABLE_FARSIGHT_SAMPLE
    help
        This option means support RGB Sample.

config SAMPLE_SUPPORT_SHT20
    bool
    prompt "Support SHT20 Sample."
    default n
    depends on ENABLE_FARSIGHT_SAMPLE
    help
        This option means support SHT20 Sample.

config SAMPLE_SUPPORT_AP3216
    bool
    prompt "Support AP3216 Sample."
    default n
    depends on ENABLE_FARSIGHT_SAMPLE
    help
        This option means support AP3216 Sample.

config SAMPLE_SUPPORT_LCD
    bool
    prompt "Support LCD Sample."
    default n
    depends on ENABLE_FARSIGHT_SAMPLE
    help
        This option means support LCD Sample.

config SAMPLE_SUPPORT_LCD_TOUCH
    bool
    prompt "Support LCD_TOUCH Sample."
    default n
    depends on ENABLE_FARSIGHT_SAMPLE
    help
        This option means support LCD_TOUCH Sample.

config SAMPLE_SUPPORT_NFC
    bool
    prompt "Support NFC Sample."
    default n
    depends on ENABLE_FARSIGHT_SAMPLE
    help
        This option means support NFC Sample.
        
config SAMPLE_SUPPORT_SC12B
    bool
    prompt "Support SC12B Sample."
    default n
    depends on ENABLE_FARSIGHT_SAMPLE
    help
        This option means support SC12B Sample.

config SAMPLE_SUPPORT_TELECONTROL_OLED
    bool
    prompt "Support TELECONTROL_OLED Sample."
    default n
    depends on ENABLE_FARSIGHT_SAMPLE
    help
        This option means support TELECONTROL_OLED Sample.

config SAMPLE_SUPPORT_SMART_TRASHCAN
    bool
    prompt "Support SMART_TRASHCAN Sample."
    default n
    depends on ENABLE_FARSIGHT_SAMPLE
    help
        This option means support SMART_TRASHCAN Sample.

config SAMPLE_SUPPORT_EC800M
    bool
    prompt "Support EC800M Sample."
    default n
    depends on ENABLE_FARSIGHT_SAMPLE
    help
        This option means support EC800M Sample.
        
config SAMPLE_SUPPORT_VOICE_CAR
    bool
    prompt "Support VOICE_CAR Sample."
    default n
    depends on ENABLE_FARSIGHT_SAMPLE
    help
        This option means support VOICE_CAR Sample.

config SAMPLE_SUPPORT_FINGERPRINT_LOCK
    bool
    prompt "Support FINGERPRINT_LOCK Sample."
    default n
    depends on ENABLE_FARSIGHT_SAMPLE
    help
        This option means support FINGERPRINT_LOCK Sample.

config SAMPLE_SUPPORT_SMART_AGRICULTURE
    bool
    prompt "Support SMART_AGRICULTURE Sample."
    default n
    depends on ENABLE_FARSIGHT_SAMPLE
    help
        This option means support SMART_AGRICULTURE Sample.
        
config SAMPLE_SUPPORT_REVERSINGRADA
    bool
    prompt "Support REVERSINGRADA Sample."
    default n
    depends on ENABLE_FARSIGHT_SAMPLE
    help
     This option means support REVERSINGRADA Sample.

config SAMPLE_SUPPORT_SMARTTEMP
    bool
    prompt "Support SMARTTEMP Sample."
    default n
    depends on ENABLE_FARSIGHT_SAMPLE
    help
     This option means support SMARTTEMP Sample.

config SAMPLE_SUPPORT_SMARTSECURITY
    bool
    prompt "Support SMARTSECURITY Sample."
    default n
    depends on ENABLE_FARSIGHT_SAMPLE
    help
     This option means support SMARTSECURITY Sample.

config SAMPLE_SUPPORT_SMARTLAMP
    bool
    prompt "Support SMARTLAMP Sample."
    default n
    depends on ENABLE_FARSIGHT_SAMPLE
    help
     This option means support SMARTLAMP Sample.

config SAMPLE_SUPPORT_SMARTFARM
    bool
    prompt "Support SMARTFARM Sample."
    default n
    depends on ENABLE_FARSIGHT_SAMPLE
    help
     This option means support SMARTFARM Sample.

config SAMPLE_SUPPORT_SMARTHOME
    bool
    prompt "Support SMARTHOME Sample."
    default n
    depends on ENABLE_FARSIGHT_SAMPLE
    help
     This option means support SMARTHOME Sample.

config SAMPLE_SUPPORT_WIFI_01_STA
    bool
    prompt "Support WIFI_01_STA Sample."
    default n
    depends on ENABLE_FARSIGHT_SAMPLE
    help
        This option means support WIFI_01_STA Sample.

config SAMPLE_SUPPORT_WIFI_02_AP
    bool
    prompt "Support WIFI_02_AP Sample."
    default n
    depends on ENABLE_FARSIGHT_SAMPLE
    help
        This option means support WIFI_02_AP Sample.

config SAMPLE_SUPPORT_WIFI_03_UDP
    bool
    prompt "Support WIFI_03_UDP Sample."
    default n
    depends on ENABLE_FARSIGHT_SAMPLE
    help
        This option means support WIFI_03_UDP Sample.

config SAMPLE_SUPPORT_WIFI_04_TCP
    bool
    prompt "Support WIFI_04_TCP Sample."
    default n
    depends on ENABLE_FARSIGHT_SAMPLE
    help
        This option means support WIFI_04_TCP Sample.

config SAMPLE_SUPPORT_WIFI_05_MQTT
    bool
    prompt "Support WIFI_05_MQTT Sample."
    default n
    depends on ENABLE_FARSIGHT_SAMPLE
    help
        This option means support WIFI_05_MQTT Sample.

config SAMPLE_SUPPORT_WIFI_06_HUAWEI_IOT
    bool
    prompt "Support WIFI_06_HUAWEI_IOT Sample."
    default n
    depends on ENABLE_FARSIGHT_SAMPLE
    help
        This option means support WIFI_06_HUAWEI_IOT Sample.

config SAMPLE_SUPPORT_BLE_TRANS_CLIENT
    bool
    prompt "Support BLE_TRANS_CLIENT Sample."
    default n
    depends on ENABLE_FARSIGHT_SAMPLE
    help
        This option means support BLE_TRANS_CLIENT Sample.

config SAMPLE_SUPPORT_BLE_TRANS_SERVER
    bool
    prompt "Support BLE_TRANS_SERVER Sample."
    default n
    depends on ENABLE_FARSIGHT_SAMPLE
    help
        This option means support BLE_TRANS_SERVER Sample.

config SAMPLE_SUPPORT_SLE_TRANS_SERVER
    bool
    prompt "Support SLE_TRANS_SERVER Sample."
    default n
    depends on ENABLE_FARSIGHT_SAMPLE
    help
        This option means support SLE_TRANS_SERVER Sample.

config SAMPLE_SUPPORT_SLE_TRANS_CLIENT
    bool
    prompt "Support SLE_TRANS_CLIENT Sample."
    default n
    depends on ENABLE_FARSIGHT_SAMPLE
    help
        This option means support SLE_TRANS_CLIENT Sample.

config SAMPLE_SUPPORT_SLE_REMOTECAR_CLIENT
    bool
    prompt "Support SLE_REMOTECAR_CLIENT Sample."
    default n
    depends on ENABLE_FARSIGHT_SAMPLE
    help
        This option means support SLE_REMOTECAR_CLIENT Sample.

config SAMPLE_SUPPORT_SLE_REMOTECAR_SERVER
    bool
    prompt "Support SLE_REMOTECAR_SERVER Sample."
    default n
    depends on ENABLE_FARSIGHT_SAMPLE
    help
        This option means support SLE_REMOTECAR_SERVER Sample.

config SAMPLE_SUPPORT_TOTAL_TEST
    bool
    prompt "Support TOTAL_TEST Sample."
    default n
    depends on ENABLE_FARSIGHT_SAMPLE
    help
        This option means support TOTAL_TEST Sample.
```

## samples/Kconfig
```kconfig
#===============================================================================
# @brief    Kconfig file.
# Copyright (c) HiSilicon (Shanghai) Technologies Co., Ltd. 2023-2023. All rights reserved.
#===============================================================================

config ENABLE_BT_SAMPLE
    bool
    prompt "Enable the Sample of BT."
    default n
    depends on SAMPLE_ENABLE
    help
        This option means enable the sample of BT.

if ENABLE_BT_SAMPLE
osource "application/samples/bt/Kconfig"
endif

config ENABLE_PERIPHERAL_SAMPLE
    bool
    prompt "Enable the Sample of peripheral."
    default n
    depends on SAMPLE_ENABLE
    help
        This option means enable the sample of peripheral.

if ENABLE_PERIPHERAL_SAMPLE
osource "application/samples/peripheral/Kconfig"
endif

config ENABLE_WIFI_SAMPLE
    bool
    prompt "Enable the Sample of WIFI."
    default n
    depends on SAMPLE_ENABLE
    help
        This option means enable the sample of WIFI.

if ENABLE_WIFI_SAMPLE
osource "application/samples/wifi/Kconfig"
endif

config ENABLE_PRODUCTS_SAMPLE
    bool
    prompt "Enable the Sample of products."
    default n
    depends on SAMPLE_ENABLE
    help
        This option means enable the sample of products.

if ENABLE_PRODUCTS_SAMPLE
osource "application/samples/products/Kconfig"
endif

config ENABLE_RADAR_SAMPLE
    bool
    prompt "Enable the Sample of RADAR."
    default n
    depends on SAMPLE_ENABLE
    help
        This option means enable the sample of RADAR.

if ENABLE_RADAR_SAMPLE
osource "application/samples/radar/Kconfig"
endif

config ENABLE_NFC_SAMPLE
    bool
    prompt "Enable the Sample of NFC."
    default n
    depends on SAMPLE_ENABLE
    help
        This option means enable the sample of NFC.

if ENABLE_NFC_SAMPLE
osource "application/samples/nfc/Kconfig"
endif

config ENABLE_FARSIGHT_SAMPLE
    bool
    prompt "Enable the Sample of Farsight."
    default n
    depends on SAMPLE_ENABLE
    help
        This option means enable the sample of Farsight.

if ENABLE_FARSIGHT_SAMPLE
osource "application/samples/Farsight/Kconfig"
endif

config ENABLE_BMS_SAMPLE
    bool
    prompt "Enable the Sample of BMS."
    default n
    depends on SAMPLE_ENABLE
    help
        This option means enable the sample of BMS.
if ENABLE_BMS_SAMPLE
osource "application/samples/BMS/Kconfig"
endif

config ENABLE_SLE_GATE_SAMPLE
    bool
    prompt "Enable the Sample of SLE GATE."
    default n
    depends on SAMPLE_ENABLE
    help
        This option means enable the sample of SLE GATE.
if ENABLE_SLE_GATE_SAMPLE
osource "application/samples/sle_gate/Kconfig"
endif
```

## samples/hybrid_demo/Kconfig
```kconfig
config SAMPLE_SUPPORT_GATEWAY
    bool
    prompt "Support gateway."
    default n
    depends on ENABLE_SLE_HYBRID
    help
        This option means support gateway Sample.


config SAMPLE_SUPPORT_HYBRID
    bool
    prompt "Support hybrid."
    default n
    depends on ENABLE_SLE_HYBRID
    help
        This option means support hybrid Sample.

config SAMPLE_SUPPORT_SERVER
    bool
    prompt "Support server."
    default n
    depends on ENABLE_SLE_HYBRID
    help
        This option means support SLE Server  Sample.

config SAMPLE_SUPPORT_MESH
    bool
    prompt "Support mesh."
    default n
    depends on ENABLE_SLE_HYBRID
    help
        This option means support mesh Sample.
```

## samples/sle_gate/Kconfig
```kconfig
config SAMPLE_SUPPORT_SLE_SERVER_ADC
    bool
    prompt "Support SLE_SERVER_ADC Sample."
    default n
    depends on ENABLE_SLE_GATE_SAMPLE
    help
        This option means support SLE_SERVER_ADC Sample.

config SAMPLE_SUPPORT_SLE_SERVER_SERIAL
    bool
    prompt "Support SLE_SERVER_SERIAL Sample."
    default n
    depends on ENABLE_SLE_GATE_SAMPLE
    help
        This option means support SLE_SERVER_SERIAL Sample.

config SAMPLE_SUPPORT_SLE_SERVER_LED
    bool
    prompt "Support SLE_SERVER_LED Sample."
    default n
    depends on ENABLE_SLE_GATE_SAMPLE
    help
        This option means support SLE_SERVER_LED Sample.

config SAMPLE_SUPPORT_SLE_CLIENT
    bool
    prompt "Support SLE_CLIENT Sample."
    default n
    depends on ENABLE_SLE_GATE_SAMPLE
    help
        This option means support SLE_CLIENT Sample.
```
